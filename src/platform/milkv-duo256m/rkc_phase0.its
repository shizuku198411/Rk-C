## src/platform/milkv-duo256m/rkc_phase0.its
```
/dts-v1/;

/ {
    description = "Rk-C Milk-V Duo256M Phase 0 bring-up";
    #address-cells = <2>;

    images {
        kernel-1 {
            description = "Rk-C kernel bring-up";
            data = /incbin/("../../../bin/milkv-duo256m/kernel.bin");
            type = "kernel";
            arch = "riscv";
            os = "linux";
            compression = "none";
            load = <0x0 0x80200000>;
            entry = <0x0 0x80200000>;

            hash-1 {
                algo = "crc32";
            };
        };

        fdt-sg2002_milkv_duo256m_musl_riscv64_sd {
            description = "cvitek device tree - sg2002_milkv_duo256m_musl_riscv64_sd";
            data = /incbin/("../../../build/milkv-duo256m/sg2002_milkv_duo256m.dtb");
            type = "flat_dt";
            arch = "riscv";
            compression = "none";

            hash-1 {
                algo = "sha256";
            };
        };
    };

    configurations {
        default = "config-sg2002_milkv_duo256m_musl_riscv64_sd";

        config-sg2002_milkv_duo256m_musl_riscv64_sd {
            description = "boot Rk-C on board sg2002_milkv_duo256m_musl_riscv64_sd";
            kernel = "kernel-1";
            fdt = "fdt-sg2002_milkv_duo256m_musl_riscv64_sd";
        };
    };
};
```
